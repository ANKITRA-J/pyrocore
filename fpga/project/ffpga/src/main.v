// Generated by tools/build_fpga.py from fpga/rtl. Edit those source files.
// Dedicated BRAM ports for SLG47910V Rev BB.
(* top *) module pyrocore_top (
  (* iopad_external_pin, clkbuf_inhibit *) input OSC_CLK,
  (* iopad_external_pin, clkbuf_inhibit *) input core_clk,
  (* iopad_external_pin *) output core_clk_out,
  (* iopad_external_pin *) output core_clk_en,
  (* iopad_external_pin *) output OSC_EN,
  (* iopad_external_pin *) output led_out,
  (* iopad_external_pin *) output led_oe,
  (* iopad_external_pin *) output [7:0] BRAM0_WDATA,
  (* iopad_external_pin *) output [8:0] BRAM0_WADDR,
  (* iopad_external_pin *) output [8:0] BRAM0_RADDR,
  (* iopad_external_pin *) output [1:0] BRAM0_RATIO,
  (* iopad_external_pin *) input BRAM0_RDATA,
  (* iopad_external_pin *) output BRAM0_nWEN,
  (* iopad_external_pin *) output BRAM0_nREN,
  (* iopad_external_pin *) output BRAM0_nWCLKEN,
  (* iopad_external_pin *) output BRAM0_nRCLKEN,
  (* iopad_external_pin *) output BRAM0_WCLKINV,
  (* iopad_external_pin *) output BRAM0_RCLKINV,
  (* iopad_external_pin *) output [7:0] BRAM1_WDATA,
  (* iopad_external_pin *) output [8:0] BRAM1_WADDR,
  (* iopad_external_pin *) output [8:0] BRAM1_RADDR,
  (* iopad_external_pin *) output [1:0] BRAM1_RATIO,
  (* iopad_external_pin *) input BRAM1_RDATA,
  (* iopad_external_pin *) output BRAM1_nWEN,
  (* iopad_external_pin *) output BRAM1_nREN,
  (* iopad_external_pin *) output BRAM1_nWCLKEN,
  (* iopad_external_pin *) output BRAM1_nRCLKEN,
  (* iopad_external_pin *) output BRAM1_WCLKINV,
  (* iopad_external_pin *) output BRAM1_RCLKINV,
  (* iopad_external_pin *) output [7:0] BRAM2_WDATA,
  (* iopad_external_pin *) output [8:0] BRAM2_WADDR,
  (* iopad_external_pin *) output [8:0] BRAM2_RADDR,
  (* iopad_external_pin *) output [1:0] BRAM2_RATIO,
  (* iopad_external_pin *) input BRAM2_RDATA,
  (* iopad_external_pin *) output BRAM2_nWEN,
  (* iopad_external_pin *) output BRAM2_nREN,
  (* iopad_external_pin *) output BRAM2_nWCLKEN,
  (* iopad_external_pin *) output BRAM2_nRCLKEN,
  (* iopad_external_pin *) output BRAM2_WCLKINV,
  (* iopad_external_pin *) output BRAM2_RCLKINV,
  (* iopad_external_pin *) output [7:0] BRAM4_WDATA,
  (* iopad_external_pin *) output [8:0] BRAM4_WADDR,
  (* iopad_external_pin *) output [8:0] BRAM4_RADDR,
  (* iopad_external_pin *) output [1:0] BRAM4_RATIO,
  (* iopad_external_pin *) input BRAM4_RDATA,
  (* iopad_external_pin *) output BRAM4_nWEN,
  (* iopad_external_pin *) output BRAM4_nREN,
  (* iopad_external_pin *) output BRAM4_nWCLKEN,
  (* iopad_external_pin *) output BRAM4_nRCLKEN,
  (* iopad_external_pin *) output BRAM4_WCLKINV,
  (* iopad_external_pin *) output BRAM4_RCLKINV,
  (* iopad_external_pin *) output [7:0] BRAM5_WDATA,
  (* iopad_external_pin *) output [8:0] BRAM5_WADDR,
  (* iopad_external_pin *) output [8:0] BRAM5_RADDR,
  (* iopad_external_pin *) output [1:0] BRAM5_RATIO,
  (* iopad_external_pin *) input BRAM5_RDATA,
  (* iopad_external_pin *) output BRAM5_nWEN,
  (* iopad_external_pin *) output BRAM5_nREN,
  (* iopad_external_pin *) output BRAM5_nWCLKEN,
  (* iopad_external_pin *) output BRAM5_nRCLKEN,
  (* iopad_external_pin *) output BRAM5_WCLKINV,
  (* iopad_external_pin *) output BRAM5_RCLKINV,
  (* iopad_external_pin *) output [7:0] BRAM6_WDATA,
  (* iopad_external_pin *) output [8:0] BRAM6_WADDR,
  (* iopad_external_pin *) output [8:0] BRAM6_RADDR,
  (* iopad_external_pin *) output [1:0] BRAM6_RATIO,
  (* iopad_external_pin *) input BRAM6_RDATA,
  (* iopad_external_pin *) output BRAM6_nWEN,
  (* iopad_external_pin *) output BRAM6_nREN,
  (* iopad_external_pin *) output BRAM6_nWCLKEN,
  (* iopad_external_pin *) output BRAM6_nRCLKEN,
  (* iopad_external_pin *) output BRAM6_WCLKINV,
  (* iopad_external_pin *) output BRAM6_RCLKINV
,
  (* iopad_external_pin *) input uart_rx_pin,
  (* iopad_external_pin *) output uart_tx_pin,
  (* iopad_external_pin *) output uart_tx_oe
);
  reg [3:0] clock_div=0;
  always @(posedge OSC_CLK) clock_div<=clock_div+4'd1;
  assign core_clk_out=clock_div[3];
  assign core_clk_en=1'b1;
  assign OSC_EN=1'b1;
  reg [7:0] startup=0;
  always @(posedge core_clk) if(!(&startup)) startup<=startup+1'b1;
  wire rst=!(&startup);
  wire mem_we,mem_wbank,mem_re,mem_rbank;
  wire [11:0] mem_waddr,mem_raddr;
  wire [2:0] mem_wdata,mem_rdata;
  wire [2:0] bank0_q,bank1_q;
  assign mem_rdata=mem_rbank ? bank1_q : bank0_q;
  assign led_oe=1'b1;
  assign uart_tx_oe=1'b1;
  pyrocore_core engine(.clk(core_clk),.rst(rst),.uart_rx_pin(uart_rx_pin),
    .uart_tx_pin(uart_tx_pin),.mem_we(mem_we),.mem_wbank(mem_wbank),
    .mem_waddr(mem_waddr),.mem_wdata(mem_wdata),.mem_re(mem_re),
    .mem_rbank(mem_rbank),.mem_raddr(mem_raddr),.mem_rdata(mem_rdata),.led(led_out));
  // Slice0: bank0, colour bit0,4096x1; extension pins hold address LSBs.
  assign BRAM0_WADDR=mem_waddr[11:3];
  assign BRAM0_RADDR=mem_raddr[11:3];
  assign BRAM0_WDATA={mem_waddr[2:0],mem_raddr[2:0],1'b0,mem_wdata[0]};
  assign BRAM0_RATIO=2'b11;
  assign BRAM0_nWEN=!(mem_we && mem_wbank==1'b0);
  assign BRAM0_nREN=!(mem_re && mem_rbank==1'b0);
  assign BRAM0_nWCLKEN=1'b0;
  assign BRAM0_nRCLKEN=1'b0;
  assign BRAM0_WCLKINV=1'b0;
  assign BRAM0_RCLKINV=1'b0;
  assign bank0_q[0]=BRAM0_RDATA;
  // Slice1: bank0, colour bit1,4096x1; extension pins hold address LSBs.
  assign BRAM1_WADDR=mem_waddr[11:3];
  assign BRAM1_RADDR=mem_raddr[11:3];
  assign BRAM1_WDATA={mem_waddr[2:0],mem_raddr[2:0],1'b0,mem_wdata[1]};
  assign BRAM1_RATIO=2'b11;
  assign BRAM1_nWEN=!(mem_we && mem_wbank==1'b0);
  assign BRAM1_nREN=!(mem_re && mem_rbank==1'b0);
  assign BRAM1_nWCLKEN=1'b0;
  assign BRAM1_nRCLKEN=1'b0;
  assign BRAM1_WCLKINV=1'b0;
  assign BRAM1_RCLKINV=1'b0;
  assign bank0_q[1]=BRAM1_RDATA;
  // Slice2: bank0, colour bit2,4096x1; extension pins hold address LSBs.
  assign BRAM2_WADDR=mem_waddr[11:3];
  assign BRAM2_RADDR=mem_raddr[11:3];
  assign BRAM2_WDATA={mem_waddr[2:0],mem_raddr[2:0],1'b0,mem_wdata[2]};
  assign BRAM2_RATIO=2'b11;
  assign BRAM2_nWEN=!(mem_we && mem_wbank==1'b0);
  assign BRAM2_nREN=!(mem_re && mem_rbank==1'b0);
  assign BRAM2_nWCLKEN=1'b0;
  assign BRAM2_nRCLKEN=1'b0;
  assign BRAM2_WCLKINV=1'b0;
  assign BRAM2_RCLKINV=1'b0;
  assign bank0_q[2]=BRAM2_RDATA;
  // Slice4: bank1, colour bit0,4096x1; extension pins hold address LSBs.
  assign BRAM4_WADDR=mem_waddr[11:3];
  assign BRAM4_RADDR=mem_raddr[11:3];
  assign BRAM4_WDATA={mem_waddr[2:0],mem_raddr[2:0],1'b0,mem_wdata[0]};
  assign BRAM4_RATIO=2'b11;
  assign BRAM4_nWEN=!(mem_we && mem_wbank==1'b1);
  assign BRAM4_nREN=!(mem_re && mem_rbank==1'b1);
  assign BRAM4_nWCLKEN=1'b0;
  assign BRAM4_nRCLKEN=1'b0;
  assign BRAM4_WCLKINV=1'b0;
  assign BRAM4_RCLKINV=1'b0;
  assign bank1_q[0]=BRAM4_RDATA;
  // Slice5: bank1, colour bit1,4096x1; extension pins hold address LSBs.
  assign BRAM5_WADDR=mem_waddr[11:3];
  assign BRAM5_RADDR=mem_raddr[11:3];
  assign BRAM5_WDATA={mem_waddr[2:0],mem_raddr[2:0],1'b0,mem_wdata[1]};
  assign BRAM5_RATIO=2'b11;
  assign BRAM5_nWEN=!(mem_we && mem_wbank==1'b1);
  assign BRAM5_nREN=!(mem_re && mem_rbank==1'b1);
  assign BRAM5_nWCLKEN=1'b0;
  assign BRAM5_nRCLKEN=1'b0;
  assign BRAM5_WCLKINV=1'b0;
  assign BRAM5_RCLKINV=1'b0;
  assign bank1_q[1]=BRAM5_RDATA;
  // Slice6: bank1, colour bit2,4096x1; extension pins hold address LSBs.
  assign BRAM6_WADDR=mem_waddr[11:3];
  assign BRAM6_RADDR=mem_raddr[11:3];
  assign BRAM6_WDATA={mem_waddr[2:0],mem_raddr[2:0],1'b0,mem_wdata[2]};
  assign BRAM6_RATIO=2'b11;
  assign BRAM6_nWEN=!(mem_we && mem_wbank==1'b1);
  assign BRAM6_nREN=!(mem_re && mem_rbank==1'b1);
  assign BRAM6_nWCLKEN=1'b0;
  assign BRAM6_nRCLKEN=1'b0;
  assign BRAM6_WCLKINV=1'b0;
  assign BRAM6_RCLKINV=1'b0;
  assign bank1_q[2]=BRAM6_RDATA;
endmodule

// Board-independent engine: command decoder, renderer ownership and frame UART.
module pyrocore_core #(
    parameter CLKS_PER_BIT=27,
    parameter FRAME_CYCLES=125000,
    parameter COMMAND_TIMEOUT=312500
)(
    input clk,input rst,input uart_rx_pin,output uart_tx_pin,
    output mem_we,output mem_wbank,output [11:0] mem_waddr,output [2:0] mem_wdata,
    output mem_re,output mem_rbank,output [11:0] mem_raddr,input [2:0] mem_rdata,
    output led
);
    wire [7:0] rx_data;wire rx_valid,rx_error,rx_busy;
    wire tx_busy,tx_start;wire [7:0] tx_data;
    uart_rx #(.CLKS_PER_BIT(CLKS_PER_BIT)) receiver(
      .clk(clk),.rst(rst),.rx_serial(uart_rx_pin),.rx_data(rx_data),
      .rx_valid(rx_valid),.rx_error(rx_error),.busy(rx_busy));
    uart_tx #(.CLKS_PER_BIT(CLKS_PER_BIT)) transmitter(
      .clk(clk),.rst(rst),.tx_start(tx_start),.tx_data(tx_data),
      .tx_serial(uart_tx_pin),.busy(tx_busy));
    reg pair_pending,command_valid;
    reg [7:0] pending_opcode,command;
    localparam TIMEOUT_BITS=$clog2(COMMAND_TIMEOUT+1);
    reg [TIMEOUT_BITS-1:0] pair_timer;
    wire opcode_known=rx_data==8'h01 || rx_data==8'h02 || rx_data==8'hf0 ||
        (rx_data>=8'h10 && rx_data<=8'h15) || (rx_data>=8'h20 && rx_data<=8'h22);
    always @(posedge clk) begin
      if(rst) begin pair_pending<=0;command_valid<=0;pending_opcode<=0;command<=0;pair_timer<=0;end
      else begin
        command_valid<=0;
        if(pair_pending) begin
          if(pair_timer==COMMAND_TIMEOUT-1) begin pair_pending<=0;pair_timer<=0;end
          else pair_timer<=pair_timer+1'b1;
        end
        if(rx_error) pair_pending<=0;
        if(rx_valid) begin
          if(pair_pending && rx_data==~pending_opcode) begin
            command<=pending_opcode;command_valid<=1;pair_pending<=0;
          end else begin
            pair_pending<=opcode_known;pending_opcode<=rx_data;
          end
          pair_timer<=0;
        end
      end
    end
    reg [2:0] material;
    reg [1:0] pattern;
    reg launch,clear,render_start;
    wire render_busy,render_done;
    particle_renderer renderer(.clk(clk),.rst(rst),.start(render_start),
      .launch(launch),.clear(clear),.material(material),.pattern(pattern),
      .busy(render_busy),.done(render_done),.pixel_we(mem_we),
      .pixel_addr(mem_waddr),.pixel_data(mem_wdata));

    reg front_bank,render_bank,front_valid,back_ready,render_inflight;
    reg [15:0] front_sequence;
    reg stream_start;
    wire stream_busy;
    localparam FRAME_BITS=$clog2(FRAME_CYCLES+1);
    reg [FRAME_BITS-1:0] frame_timer;
    wire frame_tick=frame_timer==FRAME_CYCLES-1;
    wire request=command_valid && command==8'hf0;
    assign mem_wbank=render_bank;
    assign mem_re=stream_busy;
    assign led=front_valid && (stream_busy || front_sequence[3]);
    frame_streamer streamer(.clk(clk),.rst(rst),.start(stream_start),
      .frame_bank(front_bank),.frame_seq(front_sequence),.mem_data(mem_rdata),
      .mem_bank(mem_rbank),.mem_addr(mem_raddr),.tx_busy(tx_busy),
      .tx_start(tx_start),.tx_data(tx_data),.busy(stream_busy));
    always @(posedge clk) begin
      if(rst) begin
        material<=0;pattern<=0;launch<=0;clear<=0;render_start<=0;
        front_bank<=0;render_bank<=0;front_valid<=0;back_ready<=0;
        render_inflight<=0;front_sequence<=0;stream_start<=0;frame_timer<=0;
      end else begin
        launch<=0;clear<=0;render_start<=0;stream_start<=0;
        frame_timer<=frame_tick ? 0 : frame_timer+1'b1;
        if(command_valid) begin
          if(command>=8'h10 && command<=8'h15) material<=command[2:0];
          if(command>=8'h20 && command<=8'h22) pattern<=command[1:0];
          if(command==8'h01) launch<=1;
          if(command==8'h02) clear<=1;
        end
        if(!render_inflight && !back_ready && (!front_valid || frame_tick)) begin
          render_bank<=front_valid ? !front_bank : 1'b0;
          render_start<=1;render_inflight<=1;
        end
        if(render_done && render_inflight) begin
          render_inflight<=0;
          if(!front_valid) begin front_bank<=render_bank;front_valid<=1;end
          else back_ready<=1;
        end
        // stream_start is also a guard: stream_busy rises one edge after it.
        if(back_ready && !stream_busy && !stream_start && !request) begin
          front_bank<=render_bank;front_sequence<=front_sequence+1'b1;back_ready<=0;
        end
        if(request && front_valid && !stream_busy && !stream_start) stream_start<=1;
      end
    end
endmodule

// Eight-particle fixed-point fireworks rasterizer. No framebuffer storage here.
// Caller must write pixel_* into its BACK buffer and honour busy/done.
// One previous-position trail pixel is drawn before each current head.
// Particle banks rotate once per particle, avoiding an eight-way state read mux.
module particle_renderer (
    input clk, input rst, input start, input launch, input clear,
    input [2:0] material, input [1:0] pattern,
    output reg busy, output reg done,
    output reg pixel_we, output reg [11:0] pixel_addr,
    output reg [2:0] pixel_data
);
    localparam IDLE=4'd0, CLEAR_FB=4'd1, DECIDE=4'd2, INIT=4'd3,
               READ=4'd4, STEP=4'd5, DRAW=4'd6, ADVANCE=4'd7, FINISH=4'd8, TRAIL=4'd9;
    reg [3:0] state;
    reg [11:0] clear_addr;
    reg [2:0] index;
    // Signed Q6.4 positions span -64..63.9375 pixels. Velocities are signed Q3.4.
    reg [87:0] xs, ys;
    reg [55:0] vxs, vys;
    reg [7:0] alive;
    reg [5:0] life;
    reg [2:0] active_material;
    reg launch_pending, clear_pending, frame_launch, frame_clear;
    reg [2:0] queued_material, frame_material;
    reg [1:0] queued_pattern, frame_pattern;
    reg signed [10:0] x, y, nx, ny;
    reg signed [6:0] vx, vy, nvy;
    reg particle_alive, draw_visible;
    reg [15:0] random_state;
    wire in_bounds = !nx[10] && !ny[10];
    wire [2:0] colour = active_material == 0 ? 3'd1 :
                        active_material == 1 ? 3'd2 :
                        active_material == 2 ? 3'd3 :
                        active_material == 3 ? 3'd4 :
                        active_material == 4 ? 3'd6 : 3'd7;

    reg signed [6:0] init_vx, init_vy;
    always @* begin
        // Ring: approximately equal speed around eight directions.
        case (index)
            0: begin init_vx=0;   init_vy=-32; end
            1: begin init_vx=23;  init_vy=-23; end
            2: begin init_vx=32;  init_vy=0;   end
            3: begin init_vx=23;  init_vy=23;  end
            4: begin init_vx=0;   init_vy=32;  end
            5: begin init_vx=-23; init_vy=23;  end
            6: begin init_vx=-32; init_vy=0;   end
            default: begin init_vx=-23; init_vy=-23; end
        endcase
        if (frame_pattern == 0) begin
            // Radial: alternating shorter spokes plus a small pseudorandom boost.
            if (index[0]) begin init_vx=init_vx >>> 1; init_vy=init_vy >>> 1; end
            if (random_state[0]) begin
                if (init_vx>0) init_vx=init_vx+7'sd2;
                else if (init_vx<0) init_vx=init_vx-7'sd2;
            end
        end else if (frame_pattern == 2) begin
            // Willow: upward fan launched from lower screen that gravity pulls down into falling arcs.
            case (index)
                0: init_vx=-14;
                1: init_vx=-10;
                2: init_vx=-6;
                3: init_vx=-2;
                4: init_vx=2;
                5: init_vx=6;
                6: init_vx=10;
                default: init_vx=14;
            endcase
            init_vy = index[0] ? -7'sd24 : -7'sd20;
        end
    end

    always @(posedge clk) begin
        if (rst) begin
            state<=IDLE; busy<=0; done<=0; pixel_we<=0;
            pixel_addr<=0; pixel_data<=0; clear_addr<=0; index<=0;
            alive<=0; life<=0; active_material<=0;
            launch_pending<=0; clear_pending<=0;
            frame_launch<=0; frame_clear<=0;
            queued_material<=0; queued_pattern<=0;
            frame_material<=0; frame_pattern<=0;
            // Position/velocity banks are not reset: alive=0 makes them irrelevant
            // until all eight records have been initialized by a launch.
            x<=0; y<=0; vx<=0; vy<=0; nx<=0; ny<=0; nvy<=0;
            particle_alive<=0; draw_visible<=0; random_state<=16'hACE1;
        end else begin
            done<=0;
            pixel_we<=0;
            random_state <= {random_state[14:0],random_state[15]^random_state[13]^random_state[12]^random_state[10]};
            if (launch) begin
                launch_pending<=1;
                queued_material<=material<6 ? material : 3'd0;
                queued_pattern<=pattern<3 ? pattern : 2'd0;
            end
            if (clear) begin clear_pending<=1; launch_pending<=0; end
            case (state)
                IDLE: if (start) begin
                    busy<=1; clear_addr<=0; state<=CLEAR_FB;
                    frame_clear<=clear_pending || clear;
                    frame_launch<=!(clear_pending || clear) && (launch_pending || launch);
                    frame_material<=launch ? (material<6 ? material : 3'd0) : queued_material;
                    frame_pattern<=launch ? (pattern<3 ? pattern : 2'd0) : queued_pattern;
                    launch_pending<=0; clear_pending<=0;
                end
                CLEAR_FB: begin
                    pixel_we<=1; pixel_addr<=clear_addr; pixel_data<=0;
                    clear_addr<=clear_addr+12'd1;
                    if (&clear_addr) state<=DECIDE;
                end
                DECIDE: begin
                    index<=0;
                    if (frame_clear) begin alive<=0; life<=0; state<=FINISH; end
                    else if (frame_launch) begin active_material<=frame_material; state<=INIT; end
                    else if (life!=0) begin life<=life-6'd1; state<=READ; end
                    else begin alive<=0; state<=FINISH; end
                end
                INIT: begin
                    xs<={11'd512,xs[87:11]};
                    ys<={frame_pattern==2'd2 ? 11'd640 : 11'd432,ys[87:11]};
                    vxs<={init_vx,vxs[55:7]};
                    vys<={init_vy,vys[55:7]};
                    alive<={1'b1,alive[7:1]};
                    index<=index+3'd1;
                    if (&index) begin life<=6'd48; index<=0; state<=READ; end
                end
                READ: begin
                    x<=xs[10:0]; y<=ys[10:0];
                    vx<=vxs[6:0]; vy<=vys[6:0];
                    particle_alive<=alive[0]; state<=STEP;
                end
                STEP: begin
                    nx <= x + {{4{vx[6]}},vx};
                    ny <= y + {{4{vy[6]}},vy};
                    nvy <= vy<7'sd60 ? vy+7'sd1 : vy;
                    state<=TRAIL;
                end
                TRAIL: begin
                    // Reuse the already captured old position: no history RAM.
                    // Cache visibility so an aluminium spark's head and tail
                    // flicker together even though the LFSR advances each cycle.
                    draw_visible <= particle_alive && in_bounds &&
                        !(active_material==4 && random_state[1:0]==0);
                    if (particle_alive && in_bounds &&
                        !(active_material==4 && random_state[1:0]==0)) begin
                        pixel_we<=1;
                        pixel_addr<={y[9:4],x[9:4]};
                        pixel_data<=colour;
                    end
                    state<=DRAW;
                end
                DRAW: begin
                    if (draw_visible) begin
                        pixel_we<=1;
                        pixel_addr<={ny[9:4],nx[9:4]};
                        pixel_data<=colour;
                    end
                    state<=ADVANCE;
                end
                ADVANCE: begin
                    xs<={nx,xs[87:11]}; ys<={ny,ys[87:11]};
                    vxs<={vx,vxs[55:7]}; vys<={nvy,vys[55:7]};
                    alive<={particle_alive && in_bounds,alive[7:1]};
                    index<=index+3'd1;
                    if (&index) state<=FINISH; else state<=READ;
                end
                FINISH: begin busy<=0; done<=1; state<=IDLE; end
                default: begin state<=IDLE; busy<=0; end
            endcase
        end
    end
endmodule

// Read one immutable front buffer and send a CRC-protected protocol-v1 frame.
// Eight 3-bit indices form one little-endian 24-bit payload group.
module frame_streamer (
    input clk, input rst, input start,
    input frame_bank, input [15:0] frame_seq,
    input [2:0] mem_data,
    output reg mem_bank, output reg [11:0] mem_addr,
    input tx_busy, output reg tx_start, output reg [7:0] tx_data,
    output reg busy
);
    localparam IDLE=0, HEADER=1, READ_ADDR=2, READ_CAPTURE=3,
               PAYLOAD=4, CRC=5, WAIT_HIGH=6, WAIT_LOW=7, FINISH=8;
    reg [3:0] state, after_tx;
    reg [3:0] header_index;
    reg [2:0] pixel_index;
    reg [1:0] byte_index;
    reg [23:0] pixels;
    reg [15:0] seq;
    reg [7:0] crc;
    reg [7:0] header_byte;
    function [7:0] crc_next;
        input [7:0] c, d;
        reg [7:0] v;
        integer i;
        begin
            v=c^d;
            for(i=0;i<8;i=i+1) v=v[7] ? (v<<1)^8'h07 : v<<1;
            crc_next=v;
        end
    endfunction
    always @* begin
        case(header_index)
            0:header_byte=8'h50; 1:header_byte=8'h59;
            2:header_byte=8'h01; 3:header_byte=8'h46;
            4:header_byte=seq[7:0]; 5:header_byte=seq[15:8];
            6:header_byte=8'h00; default:header_byte=8'h06;
        endcase
    end
    always @(posedge clk) begin
        if(rst) begin
            state<=IDLE; after_tx<=IDLE; busy<=0; tx_start<=0;tx_data<=0;
            mem_bank<=0;mem_addr<=0;header_index<=0;pixel_index<=0;
            byte_index<=0;pixels<=0;seq<=0;crc<=0;
        end else begin
            tx_start<=0;
            case(state)
                IDLE: if(start) begin
                    busy<=1;mem_bank<=frame_bank;seq<=frame_seq;mem_addr<=0;
                    header_index<=0;pixel_index<=0;byte_index<=0;pixels<=0;
                    crc<=0;state<=HEADER;
                end
                HEADER: if(!tx_busy) begin
                    tx_data<=header_byte;tx_start<=1;
                    if(header_index>=2) crc<=crc_next(crc,header_byte);
                    after_tx<=header_index==7 ? READ_ADDR : HEADER;
                    header_index<=header_index+1'b1;state<=WAIT_HIGH;
                end
                READ_ADDR: state<=READ_CAPTURE;
                READ_CAPTURE: begin
                    pixels<={mem_data,pixels[23:3]};
                    if(mem_addr!=12'd4095) mem_addr<=mem_addr+1'b1;
                    if(pixel_index==7) begin pixel_index<=0;byte_index<=0;state<=PAYLOAD;end
                    else begin pixel_index<=pixel_index+1'b1;state<=READ_ADDR;end
                end
                PAYLOAD: if(!tx_busy) begin
                    tx_data<=pixels[7:0];tx_start<=1;crc<=crc_next(crc,pixels[7:0]);
                    pixels<={8'd0,pixels[23:8]};
                    if(byte_index==2) after_tx<=mem_addr==4095 ? CRC : READ_ADDR;
                    else after_tx<=PAYLOAD;
                    byte_index<=byte_index+1'b1;state<=WAIT_HIGH;
                end
                CRC: if(!tx_busy) begin
                    tx_data<=crc;tx_start<=1;after_tx<=FINISH;state<=WAIT_HIGH;
                end
                WAIT_HIGH: if(tx_busy) state<=WAIT_LOW;
                WAIT_LOW: if(!tx_busy) state<=after_tx;
                FINISH: begin busy<=0;state<=IDLE;end
                default: state<=IDLE;
            endcase
        end
    end
endmodule

// UART receiver module
// 115200 baud, 8N1 format, with 2-FF synchronizer and framing error detection

module uart_rx #(
  parameter CLKS_PER_BIT = 434  // 50MHz / 115200 = 434
)(
  input clk,
  input rst,
  input rx_serial,
  output reg [7:0] rx_data,
  output reg rx_valid,
  output reg rx_error,
  output reg busy
);

  // 2-FF synchronizer for metastability protection
  reg rx_sync1, rx_sync2;
  
  // State machine
  localparam IDLE = 3'd0;
  localparam START = 3'd1;
  localparam DATA = 3'd2;
  localparam STOP = 3'd3;
  
  reg [2:0] state;
  localparam COUNTER_BITS = $clog2(CLKS_PER_BIT);
  reg [COUNTER_BITS-1:0] clk_count;
  reg [2:0] bit_index;
  reg [7:0] rx_shift;
  
  always @(posedge clk) begin
    if (rst) begin
      rx_sync1 <= 1'b1;
      rx_sync2 <= 1'b1;
      state <= IDLE;
      clk_count <= 0;
      bit_index <= 3'd0;
      rx_shift <= 8'd0;
      rx_data <= 8'd0;
      rx_valid <= 1'b0;
      rx_error <= 1'b0;
      busy <= 1'b0;
    end else begin
      // Synchronizer
      rx_sync1 <= rx_serial;
      rx_sync2 <= rx_sync1;
      
      // Clear pulse outputs
      rx_valid <= 1'b0;
      rx_error <= 1'b0;
      
      case (state)
        IDLE: begin
          busy <= 1'b0;
          clk_count <= 0;
          bit_index <= 3'd0;
          // Detect start bit (idle-to-low transition)
          if (rx_sync2 == 1'b0) begin
            state <= START;
            busy <= 1'b1;
          end
        end
        
        START: begin
          if (clk_count == (CLKS_PER_BIT - 1) / 2) begin
            // Sample at bit center
            if (rx_sync2 == 1'b0) begin
              // Valid start bit
              clk_count <= 0;
              state <= DATA;
            end else begin
              // False start bit (glitch)
              state <= IDLE;
            end
          end else begin
            clk_count <= clk_count + 1;
          end
        end
        
        DATA: begin
          if (clk_count == CLKS_PER_BIT - 1) begin
            clk_count <= 0;
            // Sample data bit (LSB first)
            rx_shift[bit_index] <= rx_sync2;
            
            if (bit_index == 3'd7) begin
              bit_index <= 3'd0;
              state <= STOP;
            end else begin
              bit_index <= bit_index + 1;
            end
          end else begin
            clk_count <= clk_count + 1;
          end
        end
        
        STOP: begin
          if (clk_count == CLKS_PER_BIT - 1) begin
            clk_count <= 0;
            // Check stop bit
            if (rx_sync2 == 1'b1) begin
              // Valid stop bit
              rx_data <= rx_shift;
              rx_valid <= 1'b1;
            end else begin
              // Framing error
              rx_error <= 1'b1;
            end
            state <= IDLE;
          end else begin
            clk_count <= clk_count + 1;
          end
        end
        
        default: state <= IDLE;
      endcase
    end
  end

endmodule

// UART transmitter module
// 115200 baud, 8N1 format

module uart_tx #(
  parameter CLKS_PER_BIT = 434  // 50MHz / 115200 = 434
)(
  input clk,
  input rst,
  input tx_start,
  input [7:0] tx_data,
  output reg tx_serial,
  output reg busy
);

  // State machine
  localparam IDLE = 3'd0;
  localparam START = 3'd1;
  localparam DATA = 3'd2;
  localparam STOP = 3'd3;
  
  reg [2:0] state;
  localparam COUNTER_BITS = $clog2(CLKS_PER_BIT);
  reg [COUNTER_BITS-1:0] clk_count;
  reg [2:0] bit_index;
  reg [7:0] tx_shift;
  
  always @(posedge clk) begin
    if (rst) begin
      state <= IDLE;
      clk_count <= 0;
      bit_index <= 3'd0;
      tx_shift <= 8'd0;
      tx_serial <= 1'b1;
      busy <= 1'b0;
    end else begin
      case (state)
        IDLE: begin
          tx_serial <= 1'b1;
          busy <= 1'b0;
          clk_count <= 0;
          bit_index <= 3'd0;
          
          if (tx_start) begin
            tx_shift <= tx_data;
            busy <= 1'b1;
            state <= START;
          end
        end
        
        START: begin
          tx_serial <= 1'b0;  // Start bit
          
          if (clk_count == CLKS_PER_BIT - 1) begin
            clk_count <= 0;
            state <= DATA;
          end else begin
            clk_count <= clk_count + 1;
          end
        end
        
        DATA: begin
          tx_serial <= tx_shift[bit_index];  // LSB first
          
          if (clk_count == CLKS_PER_BIT - 1) begin
            clk_count <= 0;
            
            if (bit_index == 3'd7) begin
              bit_index <= 3'd0;
              state <= STOP;
            end else begin
              bit_index <= bit_index + 1;
            end
          end else begin
            clk_count <= clk_count + 1;
          end
        end
        
        STOP: begin
          tx_serial <= 1'b1;  // Stop bit
          
          if (clk_count == CLKS_PER_BIT - 1) begin
            clk_count <= 0;
            state <= IDLE;
          end else begin
            clk_count <= clk_count + 1;
          end
        end
        
        default: state <= IDLE;
      endcase
    end
  end

endmodule
